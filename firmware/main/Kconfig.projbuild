## firmware/main/Kconfig.projbuild
```kconfig
menu "书童 硬件配置"

choice SHUTONG_VARIANT
    prompt "硬件版本"
    default SHUTONG_STANDARD

config SHUTONG_STANDARD
    bool "标准版 (ESP32, 无摄像头)"
config SHUTONG_FLAGSHIP
    bool "旗舰版 (ESP32-S3, OV2640摄像头)"
endchoice

config SHUTONG_SN
    string "设备序列号 (SN)"
    default "0000000000"
    help
        设备唯一序列号，10位数字。建议用Unix时间戳（date +%s），
        防止重复。烧录前执行: SN=$(date +%s) idf.py build

config MQTT_BROKER_URL
    string "MQTT Broker URL"
    default "mqtt://shutong.3198.net:1883"

config MQTT_USERNAME
    string "MQTT 用户名"
    default ""
    help
        开发兼容用固定用户名。生产环境应留空并设置 MQTT_MASTER_KEY，
        固件会自动生成 device:timestamp:signature 动态用户名。

config MQTT_PASSWORD
    string "MQTT 密码"
    default ""
    help
        固定用户名对应密码。生产环境使用动态签名时留空。

config MQTT_MASTER_KEY
    string "MQTT 主密钥"
    default ""
    help
        用于生成MQTT username签名的主密钥。开发环境通过 menuconfig 设置，
        不要提交到代码。

config WIFI_SSID_DEFAULT
    string "默认WiFi SSID"
    default "13"

config WIFI_PASS_DEFAULT
    string "默认WiFi密码"
    default "333666999"

endmenu
```

## firmware/sdkconfig.defaults
```kconfig
CONFIG_SHUTONG_FLAGSHIP=y
CONFIG_SHUTONG_SN="86217807288591"
CONFIG_MQTT_BROKER_URL="mqtt://shutong.3198.net:1883"
CONFIG_MQTT_USERNAME="st_device"
CONFIG_MQTT_PASSWORD="shutong-mqtt-2024"
CONFIG_MQTT_MASTER_KEY="34f17dc1e8f8fd6b6b16c33f7321f3d2d38e2184da1b18ec67ef9d796aba8158"
CONFIG_PARTITION_TABLE_CUSTOM=y
# CONFIG_PARTITION_TABLE_SINGLE_APP is not set
# CONFIG_PARTITION_TABLE_SINGLE_APP_LARGE is not set
# CONFIG_PARTITION_TABLE_TWO_OTA is not set
# CONFIG_PARTITION_TABLE_TWO_OTA_LARGE is not set
CONFIG_PARTITION_TABLE_CUSTOM_FILENAME="partitions.csv"
CONFIG_PARTITION_TABLE_FILENAME="partitions.csv"
CONFIG_ESPTOOLPY_FLASHSIZE_16MB=y

# PSRAM (ESP32-S3 Octal 8MB, on DFR1154)
CONFIG_SPIRAM=y
CONFIG_SPIRAM_MODE_OCT=y
CONFIG_SPIRAM_TYPE_AUTO=y
CONFIG_SPIRAM_ALLOW_BSS_SEG_EXTERNAL_MEMORY=y
CONFIG_SPIRAM_USE_CAPS_ALLOC=y
# CONFIG_CAMERA_PSRAM_DMA is not set
CONFIG_HTTPD_MAX_REQ_HDR_LEN=2048

# BLE (Eddystone-URL 广播)
CONFIG_BT_ENABLED=y
CONFIG_BT_BLUEDROID_ENABLED=y
CONFIG_BT_BLE_ENABLED=y
CONFIG_BT_BLE_42_FEATURES_SUPPORTED=y
# CONFIG_BT_BLE_50_FEATURES_SUPPORTED is not set
CONFIG_BT_CONTROLLER_ENABLED=y
```
